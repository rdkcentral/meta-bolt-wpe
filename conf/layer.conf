## conf/layer.conf
```bitbake
BBPATH .= ":${LAYERDIR}"
BBPATH .= ":${LAYERDIR}/deps/meta-rdk"
BBPATH .= ":${LAYERDIR}/deps/meta-rdk-video"
BBPATH .= ":${LAYERDIR}/deps/meta-rdk-auxiliary"
BBPATH .= ":${LAYERDIR}/deps/meta-rdk-oss-reference"
BBPATH .= ":${LAYERDIR}/deps/meta-webkit"

BBFILES += "${LAYERDIR}/recipes-*/*/*.bb \
            ${LAYERDIR}/recipes-*/*/*.bbappend"

BBFILES += "${LAYERDIR}/deps/meta-rdk/recipes-common/rdk-logger/rdk-logger_git.bb"
BBFILES += "${LAYERDIR}/deps/meta-rdk/recipes-extended/wpe-backend-rdk/wpe-backend-rdk_0.4.bb"

BBFILES += "${LAYERDIR}/deps/meta-rdk-video/recipes-extended/wpe-framework/*.bb"
BBFILES += "${LAYERDIR}/deps/meta-rdk-video/recipes-graphics/tts/tts.bb"
BBFILES += "${LAYERDIR}/deps/meta-rdk-video/recipes-extended/rdkat/*.bb"
BBFILES += "${LAYERDIR}/deps/meta-rdk-video/recipes-extended/wpe-webkit/*.bb"
BBFILES += "${LAYERDIR}/deps/meta-rdk-video/recipes-extended/rdk-browserlauncher/*.bb"

require deps/meta-rdk-oss-reference/conf/include/license_flags_accepted.inc

BBFILES += "${LAYERDIR}/deps/meta-rdk-oss-reference/recipes-core/glib-networking/glib-networking_2.72.%.bbappend"
BBFILES += "${LAYERDIR}/deps/meta-rdk-oss-reference/recipes-devtools/breakpad/breakpad_git.bbappend"
BBFILES += "${LAYERDIR}/deps/meta-rdk-oss-reference/recipes-extended/libwpe/libwpe_1.16.2.bb"
BBFILES += "${LAYERDIR}/deps/meta-rdk-oss-reference/recipes-gplv2/gawk/gawk_3.1.5.bb"
BBFILES += "${LAYERDIR}/deps/meta-rdk-oss-reference/recipes-gplv2/gmp/gmp_4.2.1.bb"
BBFILES += "${LAYERDIR}/deps/meta-rdk-oss-reference/recipes-gplv2/gnutls/gnutls_3.3.30.bb"
BBFILES += "${LAYERDIR}/deps/meta-rdk-oss-reference/recipes-gplv2/nettle/nettle_2.7.1.bb"
BBFILES += "${LAYERDIR}/deps/meta-rdk-oss-reference/recipes-graphics/cairo/cairo_1.16.0.bbappend"
BBFILES += "${LAYERDIR}/deps/meta-rdk-oss-reference/recipes-graphics/libepoxy/libepoxy_1.5.10.bbappend"
BBFILES += "${LAYERDIR}/deps/meta-rdk-oss-reference/recipes-graphics/woff2/woff2_1.0.2.bb"
BBFILES += "${LAYERDIR}/deps/meta-rdk-oss-reference/recipes-rdk/breakpad_wrapper/breakpad-wrapper.bb"
BBFILES += "${LAYERDIR}/deps/meta-rdk-oss-reference/recipes-support/ca-certificates/ca-certificates_%.bbappend"
BBFILES += "${LAYERDIR}/deps/meta-rdk-oss-reference/recipes-support/libsoup/libsoup_3.4.2.bb"

BBFILES += "${LAYERDIR}/deps/meta-webkit/recipes-browser/cog/cog_0.16.1.bb"

BBFILES += "${LAYERDIR}/deps/meta-rdk-oss-reference/recipes-multimedia/gstreamer/gstreamer*/*.bb"
BBFILES += "${LAYERDIR}/deps/meta-rdk-oss-reference/recipes-multimedia/gstreamer/gstreamer*/*.bbappend"
BBFILES += "${LAYERDIR}/deps/meta-rdk-oss-reference/recipes-multimedia/ffmpeg/*.bb"
BBFILES += "${LAYERDIR}/deps/meta-rdk-oss-reference/recipes-multimedia/ffmpeg/*.bbappend"

BBFILE_COLLECTIONS += "meta-bolt-wpe"
BBFILE_PATTERN_meta-bolt-wpe = "^${LAYERDIR}/"
BBFILE_PRIORITY_meta-bolt-wpe = "10"

LAYERDEPENDS_meta-bolt-wpe = "bolt-base"
LAYERSERIES_COMPAT_meta-bolt-wpe = "kirkstone"

MIDDLEWARE_ARCH ??= "${TUNE_PKGARCH}"

CMF_GITHUB_ROOT ?= "git://github.com/rdkcentral"
CMF_GITHUB_PROTOCOL = "https"
CMF_GITHUB_BRANCH = "nobranch=1"
CMF_GITHUB_SRC_URI_SUFFIX = "protocol=${CMF_GITHUB_PROTOCOL};${CMF_GITHUB_BRANCH}"

PREFERRED_PROVIDER_virtual/wpebackend = "wpebackend-rdk"

# gmp 4.2.1 is the last version released as LGPLv2
# nettle 2.7.1 is the last version released as LGPLv2
# gnutls 3.3.x is the last branch which supports nettle 2.7.1
PREFERRED_VERSION_gmp = "4.2.1"
PREFERRED_VERSION_nettle = "2.7.1"
PREFERRED_VERSION_gnutls = "3.3.%"
PREFERRED_VERSION_ffmpeg = "4.2.2"
PREFERRED_VERSION_wpe-webkit = "2.46.1"
DISTRO_FEATURES:append = " enable_libsoup3"

BBMASK += "poky/meta/recipes-multimedia/gstreamer/gstreamer1\.0.*"
```
